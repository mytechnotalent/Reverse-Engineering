/*
  SSD1306 driver for the Raspberry Pi Pico C SDK
  ----------------------------------------------
  Re-designed from the C++ lib from https://github.com/blippy/rpi/tree/master/1306/pico-sdk
*/

#include <string.h>
#include "pico/stdlib.h"
#include "hardware/i2c.h"

const uint8_t ssd1306_font6x8[] =
{
  0x00, 0x06, 0x08, 0x20,
  0x00, 0x00, 0x00, 0x00, 0x00, 0x00,  // sp
  0x00, 0x00, 0x00, 0x2f, 0x00, 0x00,  // !
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  0x14, 0x14, 0x14, 0x14, 0x14, 0x14,  // horiz lines, DEL
  0x00  // this byte is required for italic type of font
};

#define SET_CONTRAST 0x81
#define SET_ENTIRE_ON 0xa4
#define SET_NORM_INV 0xa6
#define SET_DISP 0xae
#define SET_MEM_ADDR 0x20
#define SET_COL_ADDR 0x21
#define SET_PAGE_ADDR 0x22
#define SET_DISP_START_LINE 0x40
#define SET_SEG_REMAP 0xa0
#define SET_MUX_RATIO 0xa8
#define SET_COM_OUT_DIR 0xc0
#define SET_DISP_OFFSET 0xd3
#define SET_COM_PIN_CFG 0xdA  // s10.1.18 page 40
#define SET_DISP_CLK_DIV 0xd5
#define SET_PRECHARGE 0xd9
#define SET_VCOM_DESEL 0xdb
#define SET_CHARGE_PUMP 0x8d

#define I2C_PORT i2c0
//#define OLED_128x32
/*
#ifdef OLED_128x32
const uint8_t height = 32;
#else
const uint8_t height = 64;
#endif
*/

static uint8_t height = 32;
const uint8_t SID = 0x3c ; // different height displays have different addr - 03d
const uint8_t width = 128;
int pages() { return height/8; }
uint8_t scr[1025]; // being: 8 pages (max) * 128 width + 1 I2C command byte

void write_cmd(uint8_t cmd);

void fill_scr(uint8_t v)
{
  memset(scr, v, sizeof(scr));
}

void send_data(uint8_t* data, int nbytes)
{
  i2c_write_blocking(I2C_PORT, SID, data, nbytes, false);
}

void send2(uint8_t v1, uint8_t v2)
{
  uint8_t buf[2];
  buf[0] = v1;
  buf[1] = v2;
  send_data(buf, 2);
}

void show_scr()
{
  write_cmd(SET_MEM_ADDR);  // 0x20
  write_cmd(0b01);  // vertical addressing mode
  write_cmd(SET_COL_ADDR);  // 0x21
  write_cmd(0);
  write_cmd(127);
  write_cmd(SET_PAGE_ADDR);  // 0x22
  write_cmd(0);
  write_cmd(pages()-1);
  scr[0] = 0x40;  // the data instruction 
  int size = pages()*width +1;
  send_data(scr, size);
}

void write_cmd(uint8_t cmd) 
{ 
  send2(0x80, cmd);
}

void power_off() { write_cmd(SET_DISP | 0x00); }

void power_on() { write_cmd(SET_DISP | 0x01); }

void contrast(uint8_t contrast) { write_cmd(SET_CONTRAST); write_cmd(contrast); }

void invert(uint8_t invert) { write_cmd(SET_NORM_INV | (invert & 1)); }

static void init_i2c()
{
  i2c_init(I2C_PORT, 100 * 1000);
  gpio_set_function(4, GPIO_FUNC_I2C);  // GPIO 4 (SDA)
  gpio_set_function(5, GPIO_FUNC_I2C);  // GPIO 5 (SCL)
  gpio_pull_up(4);
  gpio_pull_up(5);
}

void init_display(int h)
{
  init_i2c();
  height = h;
  static uint8_t cmds[] = 
  {
    SET_DISP | 0x00,  // display off 0x0e | 0x00
    SET_MEM_ADDR,  // 0x20
    0x00,  // horizontal
    SET_DISP_START_LINE | 0x00,  // 0x40
    SET_SEG_REMAP | 0x01,  // column addr 127 mapped to SEG0
    SET_COM_OUT_DIR | 0x08,  // scan from COM[N] to COM0  (0xC0 | val)
    SET_DISP_OFFSET,  // 0xd3
    0x00,
    SET_DISP_CLK_DIV,  // 0xd5
    0x80,
    SET_PRECHARGE,  // 0xd9
    0xF1,
    SET_VCOM_DESEL,  // 0xdb
    0x40,  // changed by mcarter
    SET_CONTRAST,  // 0x81
    0xFF,  // maximum
    SET_ENTIRE_ON,  // output follows RAM contents, 0xa4
    SET_NORM_INV,  // not inverted 0xa6
    SET_CHARGE_PUMP, // 0x8d
    0x14,
    SET_DISP | 0x01
  };
  for(int i=0; i<sizeof(cmds); i++)  // write all the commands
    write_cmd(cmds[i]);
  fill_scr(0);
  show_scr();
}

void draw_pixel(int16_t x, int16_t y, int color) 
{
  if(x<0 || x >= width || y<0 || y>= height) return;
  int page = y/8;
  int bit = 1<<(y % 8);
  int xincr = 8;
  xincr = height/8;
  uint8_t* ptr = scr + x*xincr + page  + 1; 
  switch (color) 
  {
    case 1:  // white
      *ptr |= bit;
      break;
    case 0:  // black
      *ptr &= ~bit;
      break;
    case -1:  // inverse
      *ptr ^= bit;
      break;
  }
}

void draw_bitmap(int16_t x, int16_t y, const uint8_t bitmap[], int16_t w,
  int16_t h, uint16_t color) 
{
  int16_t byte_width = (w + 7) / 8;  // bitmap scanline pad = whole byte
  uint8_t byte = 0;
  for (int16_t j = 0; j < h; j++, y++) 
  {
    for (int16_t i = 0; i < w; i++) 
    {
      if (i & 7)
        byte <<= 1;
      else
        byte = bitmap[j * byte_width + i / 8];
      if (byte & 0x80)
        draw_pixel(x + i, y, color);
    }
  }
}

void draw_letter_at(uint8_t x, uint8_t y, char c)
{
  if(c< ' ' || c>  0x7f) c = '?';  // 0x7F is the DEL key
  int offset = 4 + (c - ' ' )*6;
  for(int col = 0 ; col < 6; col++) 
  {
    uint8_t line =  ssd1306_font6x8[offset+col];
    for(int row =0; row <8; row++) 
    {
      draw_pixel(x+col, y+row, line & 1);
      line >>= 1;
    }
  }
  for(int row = 0; row<8; row++) 
  {
    draw_pixel(x+6, y+row, 0);
    draw_pixel(x+7, y+row, 0);
  }
}

static int cursor_x = 0, cursor_y = 0;
void ssd1306_print(const char* str)
{
  char c;
  while(c = *str) 
  {
    str++;
    if(c == '\n') 
    {
      cursor_x = 0;
      cursor_y += 8;
      continue;
    }
    draw_letter_at(cursor_x, cursor_y, c);
    cursor_x += 8;
  }
}

void set_cursor_x(int x)
{
  const int pos = 8;
  cursor_x = pos * x;
}

void set_cursor_y(int y)
{
  const int pos = 8;
  cursor_y = pos * y;
}

